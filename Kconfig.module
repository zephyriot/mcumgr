## Kconfig.module
```kconfig
# Licensed to the Apache Software Foundation (ASF) under one
# or more contributor license agreements.  See the NOTICE file
# distributed with this work for additional information
# regarding copyright ownership.  The ASF licenses this file
# to you under the Apache License, Version 2.0 (the
# "License"); you may not use this file except in compliance
# with the License.  You may obtain a copy of the License at
# 
#  http://www.apache.org/licenses/LICENSE-2.0
# 
# Unless required by applicable law or agreed to in writing,
# software distributed under the License is distributed on an
# "AS IS" BASIS, WITHOUT WARRANTIES OR CONDITIONS OF ANY
# KIND, either express or implied.  See the License for the
# specific language governing permissions and limitations
# under the License.

config MCUMGR
    bool
    prompt "mcumgr Support"
    select TINYCBOR
    default n
    help
      This option enables the mcumgr management library.

if MCUMGR

menu "Command handlers"


menuconfig MCUMGR_CMD_FS_MGMT
    bool
    prompt "Enable mcumgr handlers for file management"
    depends on FILE_SYSTEM
    default n
    help
      Enables mcumgr handlers for file management

if MCUMGR_CMD_FS_MGMT
config FS_MGMT_UL_CHUNK_SIZE
    int
    prompt "Maximum chunk size for file uploads"
    default 512
    help
      Limits the maximum chunk size for file uploads, in bytes.  A buffer of
      this size gets allocated on the stack during handling of a file upload command.

config FS_MGMT_DL_CHUNK_SIZE
    int
    prompt "Maximum chunk size for file downloads"
    default 512
    help
      Limits the maximum chunk size for file downloads, in bytes.  A buffer of
      this size gets allocated on the stack during handling of a file download
      command.

config FS_MGMT_PATH_SIZE
    int
    prompt "Maximum file path length"
    default 64
    help
      Limits the maximum path length for file operations, in bytes.  A buffer
      of this size gets allocated on the stack during handling of file upload
      and download commands.
endif


menuconfig MCUMGR_CMD_IMG_MGMT
    bool
    prompt "Enable mcumgr handlers for image management"
    select FLASH
    select MPU_ALLOW_FLASH_WRITE if CPU_HAS_MPU
    select IMG_MANAGER

    default n
    help
      Enables mcumgr handlers for image management

if MCUMGR_CMD_IMG_MGMT
config IMG_MGMT_UL_CHUNK_SIZE
    int
    prompt "Maximum chunk size for image uploads"
    default 512
    help
      Limits the maximum chunk size for image uploads, in bytes.  A buffer of
      this size gets allocated on the stack during handling of a image upload
      command.
endif


menuconfig MCUMGR_CMD_LOG_MGMT
    bool
    prompt "Enable mcumgr handlers for log management"
    depends on MDLOG
    default n
    help
      Enables mcumgr handlers for log management

if MCUMGR_CMD_LOG_MGMT
config LOG_MGMT_CHUNK_SIZE
    int
    prompt "Maximum chunk size for log downloads"
    default 512
    help
      Limits the maximum chunk size for log downloads, in bytes.  A buffer of
      this size gets allocated on the stack during handling of the log show command.

config LOG_MGMT_NAME_LEN
    int
    prompt "Maximum log name length"
    default 64
    help
      Limits the maximum length of log names, in bytes.  If a log's name length
      exceeds this number, it gets truncated in management responses.  A buffer
      of this size gets allocated on the stack during handling of all log
      management commands.

config LOG_MGMT_BODY_LEN
    int
    prompt "Maximum log body length"
    default 128
    help
      Limits the maximum length of log entry bodies, in bytes.  If a log
      entry's body length exceeds this number, it gets truncated in management
      responses.  A buffer of this size gets allocated on the stack during
      handling of the log show command.
endif



menuconfig MCUMGR_CMD_OS_MGMT
    bool
    prompt "Enable mcumgr handlers for OS management"
    select REBOOT
    default n
    help
      Enables mcumgr handlers for OS management

if MCUMGR_CMD_OS_MGMT
config OS_MGMT_RESET_MS
    int
    prompt "Delay before executing reset command (ms)"
    default 250
    help
      When a reset command is received, the system waits this many milliseconds
      before performing the reset.  This delay allows time for the mcumgr
      response to be delivered.
endif



menuconfig MCUMGR_CMD_STAT_MGMT
    bool
    prompt "Enable mcumgr handlers for statistics management"
    depends on STATS
    default n
    help
      Enables mcumgr handlers for statistics management.

if MCUMGR_CMD_STAT_MGMT
config STAT_MGMT_MAX_NAME_LEN
    int
    prompt "Maximum stat group name length"
    default 32
    help
      Limits the maximum stat group name length in mcumgr requests, in bytes.
      A buffer of this size gets allocated on the stack during handling of all
      stat read commands.  If a stat group's name exceeds this limit, it will
      be impossible to retrieve its values with a stat show command.
endif

endmenu

config APP_LINK_WITH_MCUMGR
	bool "Link 'app' with MCUMGR"
	default y
	help
	  Add MCUMGR header files to the 'app' include path. It may be
	  disabled if the include paths for MCUMGR are causing aliasing
	  issues for 'app'.

endif
```
